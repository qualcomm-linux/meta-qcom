## conf/machine/iq-x5121-evk.conf
```bitbake
#@TYPE: Machine
#@NAME: Qualcomm Purwa IoT Evaluation Kit (EVK) based on IQ-X5121
#@DESCRIPTION: Machine configuration for Qualcomm IQ-X5121 Evaluation Kit (EVK)

require conf/machine/include/qcom-purwa.inc

MACHINE_FEATURES += "efi pci tpm2"

KERNEL_DEVICETREE ?= " \
    qcom/purwa-iot-evk.dtb \
    qcom/x1-el2.dtbo \
    "

# These DTs are not upstreamed and currently exist only in linux-qcom kernels
LINUX_QCOM_KERNEL_DEVICETREE ?= " \
    qcom/purwa-evk-camx.dtbo \
    qcom/purwa-camx-el2.dtbo \
"

MACHINE_ESSENTIAL_EXTRA_RRECOMMENDS += " \
    packagegroup-purwa-iot-evk-firmware \
    packagegroup-purwa-iot-evk-hexagon-dsp-binaries \
"

# IQ-X5121 and IQ-x7181 share the same partition configuration.
QCOM_CDT_FILE = "IQ_X_EVK_CDT"
QCOM_BOOT_FILES_SUBDIR = "iq-x7181"
QCOM_PARTITION_FILES_SUBDIR ?= "partitions/iq-x7181-evk/ufs"
QCOM_PARTITION_FILES_SUBDIR_SPINOR ?= "partitions/iq-x7181-evk/spinor"

# IQ-X5121 and IQ-x7181 share the same boot firmware.
QCOM_BOOT_FIRMWARE = "firmware-qcom-boot-iq-x7181"
```

## conf/machine/iq-x7181-evk.conf
```bitbake
#@TYPE: Machine
#@NAME: Qualcomm Hamoa IoT Evaluation Kit (EVK) based on IQ-X7181
#@DESCRIPTION: Machine configuration for Qualcomm IQ-X7181 Evaluation Kit (EVK)

require conf/machine/include/qcom-hamoa.inc

MACHINE_FEATURES += "efi pci tpm2 phone"

KERNEL_DEVICETREE ?= " \
                      qcom/hamoa-iot-evk.dtb \
                      qcom/hamoa-iot-evk-camera-imx577.dtbo \
                      "

# These DTs are not upstreamed and currently exist only in linux-qcom kernels
LINUX_QCOM_KERNEL_DEVICETREE ?= " \
    qcom/hamoa-evk-camx.dtbo \
    qcom/hamoa-staging.dtbo \
"

MACHINE_ESSENTIAL_EXTRA_RRECOMMENDS += " \
    packagegroup-hamoa-iot-evk-firmware \
    packagegroup-hamoa-iot-evk-hexagon-dsp-binaries \
    qcom-fastcv-binaries-hamoa-iot-evk-dsp \
"

QCOM_CDT_FILE = "IQ_X_EVK_CDT"
QCOM_BOOT_FILES_SUBDIR = "iq-x7181"
QCOM_PARTITION_FILES_SUBDIR ?= "partitions/iq-x7181-evk/ufs"
QCOM_PARTITION_FILES_SUBDIR_SPINOR ?= "partitions/iq-x7181-evk/spinor"

QCOM_BOOT_FIRMWARE = "firmware-qcom-boot-iq-x7181"
QCOM_CDT_FIRMWARE = "firmware-qcom-cdt-iq-x7181"

CAPSULE_GUID       = "0F6D58FC-2258-4D27-9E23-D77219B0897C"

# Isolate rt cpu
QCOM_RT_CPU        = "11"
QCOM_IRQAFF        = "0-10"
QCOM_RCU_NOCBS     = "11"
QCOM_RCU_EXPEDITED = "1"
QCOM_CPUIDLE_OFF   = "1"
```

## conf/machine/kaanapali-mtp.conf
```bitbake
#@TYPE: Machine
#@NAME: Qualcomm Kaanapali Development Kit
#@DESCRIPTION: Machine configuration for Qualcomm Kaanapali development Kit

require conf/machine/include/qcom-kaanapali.inc

MACHINE_FEATURES = "efi usbhost usbgadget alsa wifi bluetooth"

QCOM_DTB_DEFAULT ?= "kaanapali-mtp"

KERNEL_DEVICETREE ?= " \
                      qcom/kaanapali-mtp.dtb \
                      "

MACHINE_ESSENTIAL_EXTRA_RRECOMMENDS += " \
    packagegroup-kaanapali-mtp-firmware \
    packagegroup-kaanapali-mtp-hexagon-dsp-binaries \
    qcom-fastcv-binaries-kaanapali-mtp-dsp \
"

QCOM_CDT_FILE = "cdt_kaanapali_mtp_0.4.0"
QCOM_BOOT_FILES_SUBDIR = "kaanapali"
QCOM_PARTITION_FILES_SUBDIR ?= "partitions/kaanapali-mtp/ufs"

QCOM_BOOT_FIRMWARE = "firmware-qcom-boot-kaanapali"
QCOM_CDT_FIRMWARE = "firmware-qcom-cdt-kaanapali"
```

## conf/machine/qcm6490-idp.conf
```bitbake
#@TYPE: Machine
#@NAME: Qualcomm QCM6490 Integrated Development Platform
#@DESCRIPTION: Machine configuration for the Integrated Development Platform, with Qualcomm QCM6490

require conf/machine/include/qcom-qcs6490.inc

MACHINE_FEATURES += "efi kvm pci phone"

KERNEL_DEVICETREE ?= " \
                      qcom/qcm6490-idp.dtb \
                      "
# These DTs are not upstreamed and currently exist only in linux-qcom kernels
LINUX_QCOM_KERNEL_DEVICETREE ?= " \
                      qcom/kodiak-el2.dtbo \
                      qcom/kodiak-staging.dtbo \
                      "

MACHINE_ESSENTIAL_EXTRA_RRECOMMENDS += " \
    packagegroup-qcm6490-idp-firmware \
    packagegroup-qcm6490-idp-hexagon-dsp-binaries \
    qairt-sdk-hexagon-v68 \
    qcom-fastcv-binaries-thundercomm-rb3gen2-dsp \
"

QCOM_CDT_FILE = "cdt_kodiak_idp_0.1.0"
QCOM_BOOT_FILES_SUBDIR = "qcm6490"

QCOM_BOOT_FIRMWARE = "firmware-qcom-boot-qcs6490"
QCOM_CDT_FIRMWARE = "firmware-qcom-cdt-qcs6490"
QCOM_PARTITION_FILES_SUBDIR ?= "partitions/qcm6490-idp/ufs"

# Isolate rt cpu
QCOM_RT_CPU        = "7"
QCOM_IRQAFF        = "0-6"
QCOM_RCU_NOCBS     = "7"
QCOM_RCU_EXPEDITED = "1"
QCOM_CPUIDLE_OFF   = "1"
```

## conf/machine/qcom-armv7a.conf
```bitbake
#@TYPE: Machine
#@NAME: Qualcomm Snapdragon ARMv7-a (with Krait cores)
#@DESCRIPTION: Unified 32-bit machine configuration for the devices with Qualcomm Snapdragon ARMv7-a based CPUs (S4 and later)
#
# Note: This machine targets Snapdragon S4 Plus/Pro/Prime and early (32-bit
# ARM) models of Snapdragon 400/600/800 series SoCs.  It will most probably
# work on Snapdragon S4 (MSM8x25, Cortex-A5 with VFPv4) or on 32-bit IPQ SoCs
#
# Do not use this machine for SDXnn modems or for Snapdragon S1/S2/S3.

require conf/machine/include/qcom-common.inc

# Krait is not Cortex-A15, but its features are close enough
DEFAULTTUNE = "cortexa15thf-neon-vfpv4"
require conf/machine/include/arm/armv7a/tune-cortexa15.inc

# Android boot image settings
QCOM_BOOTIMG_PAGE_SIZE = "2048"

MACHINE_FEATURES += "screen ext2 ext3 opengl usb"

KERNEL_IMAGETYPE ?= "zImage"
KERNEL_DEVICETREE ?= " \
    qcom/qcom-apq8064-asus-nexus7-flo.dtb \
    qcom/qcom-apq8064-ifc6410.dtb \
    qcom/qcom-apq8074-dragonboard.dtb \
    qcom/qcom-apq8084-ifc6540.dtb \
    qcom/qcom-msm8974-lge-nexus5-hammerhead.dtb \
"

MACHINE_ESSENTIAL_EXTRA_RRECOMMENDS += " \
    ${@bb.utils.contains('DISTRO_FEATURES', 'opengl', 'mesa-driver-msm', '', d)} \
    ${@bb.utils.contains('DISTRO_FEATURES', 'wifi', 'wireless-regdb-static', '', d)} \
"

SERIAL_CONSOLE ?= "115200 ttyMSM0"

QCOM_BOOTIMG_ROOTFS ?= "PARTLABEL=userdata"
```

## conf/machine/qcom-armv8a.conf
```bitbake
require conf/machine/include/qcom-common.inc
require conf/machine/include/arm/arch-armv8a.inc

MACHINE_FEATURES += "screen ext2 efi"

# UFS partitions in 820/845/RB5 setup with 4096 logical sector size
EXTRA_IMAGECMD:ext4 += " -b 4096 "

UBOOT_CONFIG ??= "qcs6490-rb3gen2 sdm845-db845c"
UBOOT_CONFIG[qcs6490-rb3gen2] = "qcm6490_defconfig"
UBOOT_CONFIG[sdm845-db845c] = "qcom_defconfig"

PREFERRED_PROVIDER_virtual/kernel ?= "linux-yocto"

# Support for dragonboard{410, 820, 845}c, rb5
KERNEL_IMAGETYPE ?= "Image.gz"

# UKI generation needs uncompressed Kernel image
KERNEL_IMAGETYPES = "Image"

# To build an Android boot image
KERNEL_CLASSES += "linux-qcom-bootimg"

# For dtb.bin generation
KERNEL_CLASSES += "linux-qcom-dtbbin"

SERIAL_CONSOLE ?= "115200 ttyMSM0"
KERNEL_DEVICETREE ?= " \
    qcom/apq8016-sbc.dtb \
    qcom/apq8096-db820c.dtb \
    qcom/hamoa-iot-evk.dtb \
    qcom/lemans-evk.dtb \
    qcom/lemans-evk-camera-csi1-imx577.dtb \
    qcom/monaco-evk.dtb \
    qcom/qcm6490-idp.dtb \
    qcom/qcs404-evb-4000.dtb \
    qcom/qcs615-ride.dtb \
    qcom/qcs6490-rb3gen2.dtb \
    qcom/qcs6490-rb3gen2-industrial-mezzanine.dtbo \
    qcom/qcs6490-rb3gen2-vision-mezzanine.dtbo \
    qcom/qcs8300-ride.dtb \
    qcom/qcs9100-ride.dtb \
    qcom/qcs9100-ride-r3.dtb \
    qcom/qrb2210-rb1.dtb \
    qcom/qrb4210-rb2.dtb \
    qcom/qrb5165-rb5.dtb \
    qcom/sa8775p-ride.dtb \
    qcom/sa8775p-ride-r3.dtb \
    qcom/sdm845-db845c.dtb \
    qcom/sm8450-hdk.dtb \
    qcom/sm8750-mtp.dtb \
"

QCOM_BOOTIMG_PAGE_SIZE[apq8016-sbc] ?= "2048"
QCOM_BOOTIMG_ROOTFS ?= "/dev/sda1"
QCOM_BOOTIMG_ROOTFS[apq8016-sbc] ?= "/dev/mmcblk0p14"
QCOM_BOOTIMG_ROOTFS[sm8450-hdk] ?= "PARTLABEL=userdata"
QCOM_BOOTIMG_ROOTFS[qcs404-evb-4000] ?= "/dev/mmcblk0p27"
QCOM_BOOTIMG_ROOTFS[qrb2210-rb1] ?= "PARTLABEL=rootfs"
QCOM_BOOTIMG_ROOTFS[qrb4210-rb2] ?= "PARTLABEL=rootfs"
QCOM_BOOTIMG_ROOTFS[qcs6490-rb3gen2] ?= "PARTLABEL=system"
SD_QCOM_BOOTIMG_ROOTFS[apq8016-sbc] ?= "/dev/mmcblk1p7"
KERNEL_CMDLINE_EXTRA[sdm845-db845c] ?= "clk_ignore_unused pd_ignore_unused"

# Userspace tools
MACHINE_ESSENTIAL_EXTRA_RRECOMMENDS += " \
    packagegroup-qcom-boot-essential \
"

MACHINE_EXTRA_RRECOMMENDS += " \
    packagegroup-qcom-boot-additional \
"

# Modules and firmware for all supported machines
MACHINE_ESSENTIAL_EXTRA_RRECOMMENDS += " \
    kernel-modules \
    ${@bb.utils.contains('DISTRO_FEATURES', 'wifi', 'wireless-regdb-static', '', d)} \
    packagegroup-dragonboard410c-firmware \
    packagegroup-dragonboard820c-firmware \
    packagegroup-dragonboard845c-firmware \
    packagegroup-rb1-firmware \
    packagegroup-rb2-firmware \
    packagegroup-rb3gen2-firmware \
    packagegroup-rb5-firmware \
"
```

## conf/machine/qcs615-adp-air.conf
```bitbake
#@TYPE: Machine
#@NAME: Qualcomm QCS615 ADP Air Beta Evaluation Kit (EVK)
#@DESCRIPTION: Machine configuration for Qualcomm ADP Air Beta Evaluation Kit (EVK), with QCS615.

require conf/machine/include/qcom-qcs615.inc

MACHINE_FEATURES += "efi pci"

QCOM_DTB_DEFAULT ?= "qcs615-ride"

KERNEL_DEVICETREE ?= " \
                      qcom/qcs615-ride.dtb \
                      "

MACHINE_ESSENTIAL_EXTRA_RRECOMMENDS += " \
    packagegroup-qcs615-adp-air-firmware \
    packagegroup-qcs615-adp-air-hexagon-dsp-binaries \
    qcom-fastcv-binaries-qcs615-ride-dsp \
"

QCOM_CDT_FILE = "cdt_adp_air_sa6155p"
QCOM_BOOT_FILES_SUBDIR = "qcs615"
QCOM_PARTITION_FILES_SUBDIR ?= "partitions/qcs615-adp-air/ufs"
```

## conf/machine/qcs615-lyra-evk.conf
```bitbake
#@TYPE: Machine
#@NAME: Qualcomm QCS615 Lyra Evaluation Kit (EVK)
#@DESCRIPTION: Machine configuration for Qualcomm QCS615 Lyra Evaluation Kit (EVK)

require conf/machine/include/qcom-qcs615.inc

MACHINE_FEATURES += "efi kvm pci"

KERNEL_DEVICETREE ?= " \
                      qcom/talos-lyra-evk.dtb \
                     "

MACHINE_ESSENTIAL_EXTRA_RRECOMMENDS += " \
    packagegroup-qcs615-lyra-evk-firmware \
    packagegroup-qcs615-lyra-evk-hexagon-dsp-binaries \
"

QCOM_BOOT_FILES_SUBDIR = "qcs615"
QCOM_PARTITION_FILES_SUBDIR ?= "partitions/qcs615-lyra-evk/ufs"
QCOM_CDT_FILE = "cdt_sm6150_8.1.0"
QCOM_BOOT_FIRMWARE = "firmware-qcom-boot-qcs615"

# Isolate rt cpu
QCOM_RT_CPU        = "7"
QCOM_IRQAFF        = "0-6"
QCOM_RCU_NOCBS     = "7"
QCOM_RCU_EXPEDITED = "1"
QCOM_CPUIDLE_OFF   = "1"
```

## conf/machine/qcs615-ride.conf
```bitbake
#@TYPE: Machine
#@NAME: Qualcomm QCS615 ADP Air Beta Evaluation Kit (EVK)
#@DESCRIPTION: Machine configuration for Qualcomm ADP Air Beta Evaluation Kit (EVK), with QCS615.

require conf/machine/include/qcom-qcs615.inc

MACHINE_FEATURES += "efi pci"

QCOM_DTB_DEFAULT ?= "qcs615-ride"

KERNEL_DEVICETREE ?= " \
                      qcom/qcs615-ride.dtb \
                      "

# These DTs are not upstreamed and currently exist only in linux-qcom kernels
LINUX_QCOM_KERNEL_DEVICETREE ?= " \
                      qcom/talos-el2.dtbo \
                      qcom/talos-staging.dtbo \
                      "

MACHINE_ESSENTIAL_EXTRA_RRECOMMENDS += " \
    packagegroup-qcs615-ride-firmware \
    packagegroup-qcs615-ride-hexagon-dsp-binaries \
    qcom-fastcv-binaries-qcs615-ride-dsp \
"

QCOM_CDT_FILE = "cdt_adp_air_sa6155p"
QCOM_BOOT_FILES_SUBDIR = "qcs615"
QCOM_PARTITION_FILES_SUBDIR ?= "partitions/qcs615-ride/ufs"

QCOM_BOOT_FIRMWARE = "firmware-qcom-boot-qcs615"
QCOM_CDT_FIRMWARE = "firmware-qcom-cdt-qcs615"

# Isolate rt cpu
QCOM_RT_CPU        = "7"
QCOM_IRQAFF        = "0-6"
QCOM_RCU_NOCBS     = "7"
QCOM_RCU_EXPEDITED = "1"
QCOM_CPUIDLE_OFF   = "1"

UBOOT_CONFIG = "qcs615-ride"
```

## conf/machine/qcs615-talos-evk.conf
```bitbake
#@TYPE: Machine
#@NAME: Qualcomm QCS615 Talos Evaluation Kit (EVK)
#@DESCRIPTION: Machine configuration for Qualcomm QCS615 Talos Evaluation Kit (EVK)

require conf/machine/include/qcom-qcs615.inc

MACHINE_FEATURES += "efi kvm pci"

KERNEL_DEVICETREE ?= " \
                      qcom/talos-evk.dtb \
                      qcom/talos-evk-camera-imx577.dtbo \
                      qcom/talos-evk-lvds-auo,g133han01.dtbo \
                      "

# These DTs are not upstreamed and currently exist only in linux-qcom kernels
LINUX_QCOM_KERNEL_DEVICETREE ?= " \
                      qcom/talos-evk-camx.dtbo \
                      qcom/talos-el2.dtbo \
                      qcom/talos-staging.dtbo \
                      qcom/talos-evk-staging.dtbo \
                      "

MACHINE_ESSENTIAL_EXTRA_RRECOMMENDS += " \
    packagegroup-qcs615-talos-evk-firmware \
    packagegroup-qcs615-talos-evk-hexagon-dsp-binaries \
    qairt-sdk-hexagon-v66 \
    qps615-dlkm \
"

QCOM_BOOT_FILES_SUBDIR = "qcs615-talos"
QCOM_PARTITION_FILES_SUBDIR ?= "partitions/qcs615-talos-evk/emmc"
QCOM_CDT_FILE = "cdt_sm6150_4.1.0"
QCOM_BOOT_FIRMWARE = "firmware-qcom-boot-qcs615"
QCOM_CDT_FIRMWARE = "firmware-qcom-cdt-qcs615"

# Isolate rt cpu
QCOM_RT_CPU        = "7"
QCOM_IRQAFF        = "0-6"
QCOM_RCU_NOCBS     = "7"
QCOM_RCU_EXPEDITED = "1"
QCOM_CPUIDLE_OFF   = "1"

UBOOT_CONFIG = "qcs615-talos-evk"
```

## conf/machine/qcs6490-rb3gen2-core-kit.conf
```bitbake
#@TYPE: Machine
#@NAME: Qualcomm RB3Gen2 Development Kit (Core Kit)
#@DESCRIPTION: Machine configuration for Qualcomm RB3Gen2 development Kit, with QCS6490
#DEPRECATED, use rb3gen2-core-kit instead

require conf/machine/rb3gen2-core-kit.conf
```
