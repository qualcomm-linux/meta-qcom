## conf/machine/include/fit-dtb-compatible.inc
```bitbake
# Mapping from a Device Tree compatible string to the DTB (and optional
# overlays) that implement it.
#
# Syntax:
# FIT_DTB_COMPATIBLE[<compatible-encoded>] = "<dtb-stem> [<overlay-stem> [<overlay-stem>...]]"
#
# <compatible-encoded> is the DT compatible string with every comma replaced
# by an underscore (BitBake flag names cannot contain commas).  For example,
# "qcom,apq8016-sbc" is written as "qcom_apq8016-sbc".
#
# Rules
# -----
# - linux-qcom tracks a newer kernel than linux-yocto, so it can carry extra
#   device trees -- both .dtb and .dtbo -- that have not landed in linux-yocto
#   yet.  Entries that rely on those linux-qcom-only device trees are kept in
#   fit-dtb-compatible-linux-qcom.inc.  Splitting them out lets linux-qcom add
#   device trees quickly while a build using only linux-yocto stays functional
#   from this file alone; as linux-yocto is updated and gains the same device
#   trees, the corresponding entries migrate back into this file.
# - do_generate_qcom_fitimage silently skips any combo whose files are absent
#   from KERNEL_DEVICETREE, so entries here are safe to leave even when a
#   particular machine or kernel does not include every listed file.

# ---------- Direct mapping, no overlay ----------
FIT_DTB_COMPATIBLE[qcom_apq8016-sbc] = "apq8016-sbc"
FIT_DTB_COMPATIBLE[qcom_apq8064-ifc6410] = "qcom-apq8064-ifc6410"
FIT_DTB_COMPATIBLE[qcom_apq8064] = "qcom-apq8064-asus-nexus7-flo"
FIT_DTB_COMPATIBLE[qcom_apq8074-dragonboard] = "qcom-apq8074-dragonboard"
FIT_DTB_COMPATIBLE[qcom_apq8084-sbc] = "qcom-apq8084-ifc6540"
FIT_DTB_COMPATIBLE[qcom_apq8096-sbc] = "apq8096-db820c"
FIT_DTB_COMPATIBLE[qcom_glymur-crd] = "glymur-crd"
FIT_DTB_COMPATIBLE[qcom_kaanapali-mtp] = "kaanapali-mtp"
FIT_DTB_COMPATIBLE[qcom_msm8974] = "qcom-msm8974-lge-nexus5-hammerhead"
FIT_DTB_COMPATIBLE[qcom_purwa-evk] = "purwa-iot-evk"
FIT_DTB_COMPATIBLE[qcom_qcs404-evb-4000] = "qcs404-evb-4000"
FIT_DTB_COMPATIBLE[qcom_qrb2210-rb1] = "qrb2210-rb1"
FIT_DTB_COMPATIBLE[qcom_qrb4210-rb2] = "qrb4210-rb2"
FIT_DTB_COMPATIBLE[qcom_qrb5165-rb5] = "qrb5165-rb5"
FIT_DTB_COMPATIBLE[qcom_sdm845] = "sdm845-db845c"
FIT_DTB_COMPATIBLE[qcom_sm8450-hdk] = "sm8450-hdk"
FIT_DTB_COMPATIBLE[qcom_sm8750-mtp] = "sm8750-mtp"

# ---------- hamoa ----------
FIT_DTB_COMPATIBLE[qcom_hamoa-evk] = \
    "hamoa-iot-evk hamoa-iot-evk-camera-imx577"

# ---------- purwa ----------
FIT_DTB_COMPATIBLE[qcom_purwa-evk-el2kvm] = "purwa-iot-evk x1-el2"

# ---------- lemans ----------
FIT_DTB_COMPATIBLE[qcom_qcs9075-iot] = \
    "lemans-evk lemans-evk-camera-csi1-imx577"

FIT_DTB_COMPATIBLE[qcom_qcs9100-qam] = "qcs9100-ride"
FIT_DTB_COMPATIBLE[qcom_qcs9100-qam-r2.0] = "qcs9100-ride-r3"

FIT_DTB_COMPATIBLE[qcom_sa8775p-qam] = "sa8775p-ride"
FIT_DTB_COMPATIBLE[qcom_sa8775p-qam-r2.0] = "sa8775p-ride-r3"

# ---------- monaco ----------
FIT_DTB_COMPATIBLE[qcom_qcs8275-iot] = \
    "monaco-evk monaco-evk-camera-imx577"

FIT_DTB_COMPATIBLE[qcom_qcs8300-adp] = "qcs8300-ride"

# ---------- shikra ----------
FIT_DTB_COMPATIBLE[qcom_shikracqm-itp] = "shikra-cqm-evk shikra-cqm-evk-imx577-camera"
FIT_DTB_COMPATIBLE[qcom_shikracqs-itp] = "shikra-cqs-evk shikra-cqm-evk-imx577-camera"
FIT_DTB_COMPATIBLE[qcom_shikraiqs-itp] = "shikra-iqs-evk shikra-iqs-evk-imx577-camera"

# ---------- talos ----------
FIT_DTB_COMPATIBLE[qcom_qcs615-adp] = "qcs615-ride"
FIT_DTB_COMPATIBLE[qcom_qcs615-iot] = "talos-evk talos-evk-camera-imx577"
FIT_DTB_COMPATIBLE[qcom_talos-evk-lvds-auo_g133han01] = \
    "talos-evk talos-evk-lvds-auo_g133han01"

# ---------- kodiak ----------
FIT_DTB_COMPATIBLE[qcom_qcm6490-idp] = "qcm6490-idp"

FIT_DTB_COMPATIBLE[qcom_qcs5430-iot] = "qcs6490-rb3gen2"
FIT_DTB_COMPATIBLE[qcom_qcs6490-iot] = "qcs6490-rb3gen2"

FIT_DTB_COMPATIBLE[qcom_qcs5430-iot-subtype9] = \
    "qcs6490-rb3gen2 qcs6490-rb3gen2-industrial-mezzanine"
FIT_DTB_COMPATIBLE[qcom_qcs6490-iot-subtype9] = \
    "qcs6490-rb3gen2 qcs6490-rb3gen2-industrial-mezzanine"
FIT_DTB_COMPATIBLE[qcom_qcs6490-iot-subtype13] = \
    "qcs6490-rb3gen2 qcs6490-rb3gen2-industrial-mezzanine qcs6490-rb3gen2-industrial-mezzanine-m2-cologne"

FIT_DTB_COMPATIBLE[qcom_qcs5430-iot-subtype2] = \
    "qcs6490-rb3gen2 qcs6490-rb3gen2-vision-mezzanine"
FIT_DTB_COMPATIBLE[qcom_qcs6490-iot-subtype2] = \
    "qcs6490-rb3gen2 qcs6490-rb3gen2-vision-mezzanine"
```

## conf/machine/include/qcom-common.inc
```bitbake
require conf/machine/include/soc-family.inc
require conf/machine/include/fit-dtb-compatible.inc
MACHINEOVERRIDES =. "qcom:"

# Set a default set of MACHINE_FEATURES, indivudual MACHINEs can append it
MACHINE_FEATURES = "alsa bluetooth usbgadget usbhost wifi"

XSERVER_OPENGL ?= " \
    xf86-video-modesetting \
    xserver-xorg-extension-glx \
"

XSERVER ?= " \
    xserver-xorg \
    xserver-xorg-module-libint10 \
    ${@bb.utils.contains('DISTRO_FEATURES', 'opengl', '${XSERVER_OPENGL}', 'xf86-video-fbdev', d)} \
    xf86-input-evdev \
"

PREFERRED_PROVIDER_virtual/kernel ??= "linux-yocto"

# Device Trees specific to linux-qcom family of kernels
LINUX_QCOM_KERNEL_DEVICETREE ??= ""
KERNEL_DEVICETREE:append:pn-linux-qcom = " ${LINUX_QCOM_KERNEL_DEVICETREE}"
KERNEL_DEVICETREE:append:pn-linux-qcom-next = " ${LINUX_QCOM_KERNEL_DEVICETREE}"
KERNEL_DEVICETREE:append:pn-linux-qcom-rt = " ${LINUX_QCOM_KERNEL_DEVICETREE}"
KERNEL_DEVICETREE:append:pn-linux-qcom-next-rt = " ${LINUX_QCOM_KERNEL_DEVICETREE}"

PREFERRED_PROVIDER_android-tools-conf = "android-tools-conf-configfs"

# Fastboot expects an ext4 image, which needs to be 4096 aligned
IMAGE_FSTYPES ?= "ext4.gz"
IMAGE_ROOTFS_ALIGNMENT ?= "4096"

# Android boot image settings
QCOM_BOOTIMG_KERNEL_BASE ?= "0x80000000"
QCOM_BOOTIMG_PAGE_SIZE ?= "4096"

# Default vfat sector size to 4096, compatible with UFS
QCOM_VFAT_SECTOR_SIZE ??= "4096"

# Default serial console for QCOM devices
SERIAL_CONSOLES ?= "115200;ttyMSM0"

# Increase INITRAMFS_MAXSIZE to 640 MiB to cover initramfs-kerneltest-full
# image.  All our boards (except db410c) have 2GiB and db410c has 1GiB of RAM,
# so this image would fit.
INITRAMFS_MAXSIZE = "655360"
# This initramfs is bigger than the others
INITRAMFS_MAXSIZE:pn-initramfs-kerneltest-full-image = "983040"

# Use systemd-boot as the EFI bootloader
EFI_PROVIDER = "systemd-boot"

# Unified Kernel Image (UKI) name
EFI_LINUX_IMG ?= "linux-${MACHINE}.efi"

# Pass additional options to mkimage command
# The -E option enables external data in FIT images, which is essential for
# modular boot setups, secure boot workflows, and reducing image size.
# The -B 8 option enforces 8-byte alignment, as per QCOM UEFI requirements.
FIT_DTB_MKIMAGE_EXTRA_OPTS ?= "-E -B 8"

# Default values (machines override these)
QCOM_RT_CPU           ?= ""
QCOM_IRQAFF           ?= ""
QCOM_RCU_NOCBS        ?= ""
QCOM_RCU_EXPEDITED    ?= ""
QCOM_CPUIDLE_OFF      ?= ""

# Per-arg conditionals
RT_ARGS_ISOL  = "${@oe.utils.conditional('QCOM_RT_CPU',        '', '', \
                'isolcpus=${QCOM_RT_CPU}',              d)}"
RT_ARGS_IRQ   = "${@oe.utils.conditional('QCOM_IRQAFF',        '', '', \
                'irqaffinity=${QCOM_IRQAFF}',           d)}"
RT_ARGS_NOCBS = "${@oe.utils.conditional('QCOM_RCU_NOCBS',     '', '', \
                'rcu_nocbs=${QCOM_RCU_NOCBS}',          d)}"
RT_ARGS_EXP   = "${@oe.utils.conditional('QCOM_RCU_EXPEDITED', '', '', \
                'rcupdate.rcu_expedited=${QCOM_RCU_EXPEDITED}', d)}"
RT_ARGS_IDLE  = "${@oe.utils.conditional('QCOM_CPUIDLE_OFF',   '', '', \
                'cpuidle.off=${QCOM_CPUIDLE_OFF}',      d)}"

# Combine
RT_KERNEL_CMDLINE = "${RT_ARGS_ISOL} ${RT_ARGS_IRQ} ${RT_ARGS_NOCBS} \
                     ${RT_ARGS_EXP} ${RT_ARGS_IDLE}"

# Append only when RT kernel is selected
KERNEL_CMDLINE_EXTRA:append = "${@bb.utils.contains_any('PREFERRED_PROVIDER_virtual/kernel',\
                              'linux-qcom-rt linux-qcom-next-rt', \
                              ' ${RT_KERNEL_CMDLINE}', '', d)}"
```

## conf/machine/include/qcom-hamoa.inc
```bitbake
# Configurations and variables for hamoa SoC family.

SOC_FAMILY = "hamoa"
require conf/machine/include/qcom-base.inc
require conf/machine/include/qcom-common.inc

DEFAULTTUNE = "armv8-6a-crypto"
require conf/machine/include/arm/arch-armv8-6a.inc

MACHINE_ESSENTIAL_EXTRA_RRECOMMENDS += " \
    packagegroup-qcom-boot-essential \
    packagegroup-machine-essential-qcom-hamoa-soc \
"

MACHINE_EXTRA_RRECOMMENDS += " \
    packagegroup-qcom-boot-additional \
"
```

## conf/machine/include/qcom-kaanapali.inc
```bitbake
# Configurations and variables for Kaanapali SoC family.

SOC_FAMILY = "kaanapali"
require conf/machine/include/qcom-base.inc
require conf/machine/include/qcom-common.inc

DEFAULTTUNE = "armv8-6a-crypto"
require conf/machine/include/arm/arch-armv8-6a.inc

MACHINE_ESSENTIAL_EXTRA_RRECOMMENDS += " \
    packagegroup-qcom-boot-essential \
"
```

## conf/machine/include/qcom-purwa.inc
```bitbake
# Configurations and variables for Purwa SoC family.

SOC_FAMILY = "purwa"
require conf/machine/include/qcom-base.inc
require conf/machine/include/qcom-common.inc

QCOM_VFAT_SECTOR_SIZE = "512"

DEFAULTTUNE = "armv8-6a-crypto"
require conf/machine/include/arm/arch-armv8-6a.inc

MACHINE_ESSENTIAL_EXTRA_RRECOMMENDS += " \
    packagegroup-qcom-boot-essential \
    packagegroup-machine-essential-qcom-purwa-soc \
"

MACHINE_EXTRA_RRECOMMENDS += " \
    packagegroup-qcom-boot-additional \
"
```

## conf/machine/include/qcom-qcs6490.inc
```bitbake
# Configurations and variables for QCS6490 SoC family.

SOC_FAMILY = "qcm6490"
require conf/machine/include/qcom-base.inc
require conf/machine/include/qcom-common.inc

DEFAULTTUNE = "armv8-2a-crypto"
require conf/machine/include/arm/arch-armv8-2a.inc

MACHINE_ESSENTIAL_EXTRA_RRECOMMENDS += " \
    packagegroup-qcom-boot-essential \
    packagegroup-machine-essential-qcom-qcs6490-soc \
"

MACHINE_EXTRA_RRECOMMENDS += " \
    packagegroup-qcom-boot-additional \
"

# Post-DDR DTB embedded inside xbl_config.elf for QCM6490 (Kodiak).
# Used by qcom-capsule.bbclass to locate the DTB into which the OEM
# capsule root certificate is injected at build time.
XBLCONFIG_DTB ?= "post-ddr-kodiak-1.0.dtb"
```

## conf/machine/include/qcom-qrb2210.inc
```bitbake
# Configurations and variables for QCS6490 SoC family.

SOC_FAMILY = "qrb2210"
require conf/machine/include/qcom-base.inc
require conf/machine/include/qcom-common.inc

require conf/machine/include/arm/armv8a/tune-cortexa53.inc

KERNEL_CMDLINE_EXTRA ?= "earlycon clk_ignore_unused pd_ignore_unused"

EXTRA_IMAGEDEPENDS += "firmware-qcom-boot-qrb2210-rb1 qcom-gen-partition-bins"
```

## conf/machine/include/qcom-u-boot-common.inc
```bitbake
# Copyright (c) 2026 Qualcomm Innovation Center, Inc. All rights reserved.
#
# SPDX-License-Identifier: BSD-3-Clause-Clear
#

UBOOT_CONFIG ?= ""
UBOOT_CONFIG_DEFAULT ?= "${UBOOT_CONFIG}"

UBOOT_INITIAL_ENV = ""

# Don't forget to add config to qcom-armv8a.conf when adding it here
UBOOT_CONFIG[iq-615-evk] = "qcom_qcs615_defconfig"
UBOOT_CONFIG[iq-9075-evk] = "qcom_lemans_defconfig"
UBOOT_CONFIG[qcs9100-ride-sx] = "qcom_lemans_defconfig"
UBOOT_CONFIG[qcs615-ride] = "qcom_qcs615_defconfig"
UBOOT_CONFIG[qcs6490-rb3gen2] = "qcm6490_defconfig"
UBOOT_CONFIG[qrb2210-rb1] = "qcom_defconfig"
UBOOT_CONFIG[sdm845-db845c] = "qcom_defconfig"
UBOOT_CONFIG[shikra-evk] = "qcom_shikra_defconfig"

BOARD_MBN_HEADER[iq-615-evk] = "v6"
BOARD_MBN_HEADER[iq-9075-evk] = "v6"
BOARD_MBN_HEADER[qcs9100-ride-sx] = "v6"
BOARD_MBN_HEADER[qcs615-ride] = "v6"
BOARD_MBN_HEADER[qcs6490-rb3gen2] = "v6"
BOARD_MBN_HEADER[qrb2210-rb1] = "v5"
BOARD_MBN_HEADER[sdm845-db845c] = "v6"
BOARD_MBN_HEADER[shikra-evk] = "v6"

UBOOT_ENTRYPOINT:qcm6490 ?= "0xa0000000"
UBOOT_ENTRYPOINT:qcs9100 ?= "0xb0800000"
```

## conf/machine/iq-615-evk.conf
```bitbake
#@TYPE: Machine
#@NAME: Qualcomm IQ-615 Evaluation Kit (EVK) based on QCS615
#@DESCRIPTION: Machine configuration for Qualcomm IQ-615 Evaluation Kit (EVK)

require conf/machine/include/qcom-qcs615.inc

MACHINE_FEATURES += "efi kvm pci"

KERNEL_DEVICETREE ?= " \
                      qcom/talos-evk.dtb \
                      qcom/talos-evk-camera-imx577.dtbo \
                      qcom/talos-evk-lvds-auo,g133han01.dtbo \
                      "

# These DTs are not upstreamed and currently exist only in linux-qcom kernels
LINUX_QCOM_KERNEL_DEVICETREE ?= " \
                      qcom/talos-evk-camx.dtbo \
                      qcom/talos-el2.dtbo \
                      qcom/talos-staging.dtbo \
                      qcom/talos-evk-staging.dtbo \
                      "

MACHINE_ESSENTIAL_EXTRA_RRECOMMENDS += " \
    packagegroup-iq-615-evk-firmware \
    packagegroup-iq-615-evk-hexagon-dsp-binaries \
    qairt-sdk-hexagon-v66 \
    qcom-fastcv-binaries-qcs615-ride-dsp \
    qps615-dlkm \
"

QCOM_BOOT_FILES_SUBDIR = "qcs615"
QCOM_PARTITION_FILES_SUBDIR ?= "partitions/iq-615-evk/emmc"
QCOM_CDT_FILE = "cdt_sm6150_4.1.0"
QCOM_BOOT_FIRMWARE = "firmware-qcom-boot-qcs615"
QCOM_CDT_FIRMWARE = "firmware-qcom-cdt-qcs615"

# Isolate rt cpu
QCOM_RT_CPU        = "7"
QCOM_IRQAFF        = "0-6"
QCOM_RCU_NOCBS     = "7"
QCOM_RCU_EXPEDITED = "1"
QCOM_CPUIDLE_OFF   = "1"

UBOOT_CONFIG = "iq-615-evk"
```

## conf/machine/iq-8275-evk.conf
```bitbake
#@TYPE: Machine
#@NAME: Qualcomm IQ-8275 Evaluation Kit (EVK) based on QCS8275
#@DESCRIPTION: Machine configuration for Qualcomm IQ-8275 Evaluation Kit (EVK)

require conf/machine/include/qcom-qcs8300.inc

MACHINE_FEATURES += "efi pci"

KERNEL_DEVICETREE ?= " \
                      qcom/monaco-evk.dtb \
                      qcom/monaco-evk-camera-imx577.dtbo \
                      "

# These DTs are not upstreamed and currently exist only in linux-qcom kernels
LINUX_QCOM_KERNEL_DEVICETREE ?= " \
                      qcom/monaco-evk-camx.dtbo \
                      "

MACHINE_ESSENTIAL_EXTRA_RRECOMMENDS += " \
    packagegroup-iq-8275-evk-firmware \
    packagegroup-iq-8275-evk-hexagon-dsp-binaries \
    qairt-sdk-hexagon-v75 \
    qcom-fastcv-binaries-qcs8300-ride-dsp \
"

QCOM_CDT_FILE = "cdt_qcs8275_iq_8275_evk_pro_sku"
QCOM_BOOT_FILES_SUBDIR = "qcs8300"
QCOM_PARTITION_FILES_SUBDIR ?= "partitions/iq-8275-evk/ufs"

QCOM_BOOT_FIRMWARE = "firmware-qcom-boot-qcs8300"
```

## conf/machine/iq-9075-evk.conf
```bitbake
#@TYPE: Machine
#@NAME: Qualcomm IQ-9075 Evaluation Kit (EVK) based on QCS9075
#@DESCRIPTION: Machine configuration for Qualcomm IQ-9075 Evaluation Kit (EVK)

require conf/machine/include/qcom-qcs9100.inc

MACHINE_FEATURES += "efi pci tpm2"

KERNEL_DEVICETREE ?= " \
                      qcom/lemans-evk.dtb \
                      qcom/lemans-evk-camera-csi1-imx577.dtbo \
                      "

# These DTs are not upstreamed and currently exist only in linux-qcom kernels
LINUX_QCOM_KERNEL_DEVICETREE ?= " \
                      qcom/lemans-el2.dtbo \
                      qcom/lemans-evk-camx.dtbo \
                      qcom/lemans-evk-camx-el2.dtbo \
                      "

MACHINE_ESSENTIAL_EXTRA_RRECOMMENDS += " \
    packagegroup-iq-9075-evk-firmware \
    packagegroup-iq-9075-evk-hexagon-dsp-binaries \
    qairt-sdk-hexagon-v73 \
    qcom-fastcv-binaries-sa8775p-ride-dsp \
"

QCOM_CDT_FILE = "cdt_rb8_core_kit"
QCOM_BOOT_FILES_SUBDIR = "qcs9100"
QCOM_PARTITION_FILES_SUBDIR ?= "partitions/iq-9075-evk/ufs"

QCOM_BOOT_FIRMWARE = "firmware-qcom-boot-qcs9100"

# Isolate rt cpu
QCOM_RT_CPU        = "7"
QCOM_IRQAFF        = "0-6"
QCOM_RCU_NOCBS     = "7"
QCOM_RCU_EXPEDITED = "1"
QCOM_CPUIDLE_OFF   = "1"
```
