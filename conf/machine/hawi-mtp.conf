## conf/machine/shikra-evk.conf
```bitbake
#@TYPE: Machine
#@NAME: Qualcomm Shikra Alpha Evaluation Kit (EVK)
#@DESCRIPTION: Machine configuration for Qualcomm Shikra Evaluation Kit (EVK)

require conf/machine/include/qcom-shikra.inc

MACHINE_FEATURES += "kvm m2connector phone tpm2"

KERNEL_DEVICETREE ?= " \
                      qcom/shikra-cqm-evk.dtb \
                      qcom/shikra-cqs-evk.dtb \
                      qcom/shikra-iqs-evk.dtb \
                      qcom/shikra-cqm-evk-imx577-camera.dtbo \
                      qcom/shikra-iqs-evk-imx577-camera.dtbo \
                      qcom/shikra-cqm-cqs-evk-hdmi.dtbo \
                      qcom/shikra-iqs-evk-dlc-panel.dtbo \
                      qcom/shikra-iqs-evk-lvds-auo,g133han01.dtbo \
                      "

LINUX_QCOM_KERNEL_DEVICETREE ?= " \
                      qcom/shikra-el2.dtbo \
                      qcom/shikra-cqs-evk-camx.dtbo \
                      qcom/shikra-iqs-evk-camx.dtbo \
                      qcom/shikra-cqm-evk-camx.dtbo \
                      qcom/shikra-iqs-evk-m2-wifi-bt.dtbo \
                      "

MACHINE_ESSENTIAL_EXTRA_RRECOMMENDS += " \
    packagegroup-shikra-evk-firmware \
    packagegroup-shikra-evk-hexagon-dsp-binaries \
    qcom-fastcv-binaries-shikra-evk-dsp \
"

QCOM_FLASH_VARIANTS ?= "cq2390-itp iq2390-itp"
QCOM_FLASH_VARIANT_CDT[cq2390-itp] = "cdt_cq2390_itp_0.2.0"
QCOM_FLASH_VARIANT_CDT[iq2390-itp] = "cdt_iq2390_itp_0.4.0"
QCOM_BOOT_FILES_SUBDIR = "shikra"
QCOM_PARTITION_FILES_SUBDIR ?= "partitions/shikra-evk/emmc"

QCOM_BOOT_FIRMWARE = "firmware-qcom-boot-shikra"
QCOM_CDT_FIRMWARE = "firmware-qcom-cdt-shikra"

UBOOT_CONFIG = "shikra-evk"

# Isolate rt cpu
QCOM_RT_CPU        = "3"
QCOM_IRQAFF        = "0-2"
QCOM_RCU_NOCBS     = "3"
QCOM_RCU_EXPEDITED = "1"
QCOM_CPUIDLE_OFF   = "1"
```
