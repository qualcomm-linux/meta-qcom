## conf/machine/eliza-evk-emmc.conf
```bitbake
#@TYPE: Machine
#@NAME: Qualcomm Eliza Evaluation Kit (EVK)
#@DESCRIPTION: Machine configuration for Qualcomm Eliza Evaluation Kit (EVK)

require conf/machine/include/qcom-eliza.inc

MACHINE_FEATURES += "efi m2connector pci"

KERNEL_DEVICETREE ?= " \
    qcom/eliza-cqs-evk-emmc.dtb \
"

MACHINE_ESSENTIAL_EXTRA_RRECOMMENDS += " \
    packagegroup-eliza-evk-firmware \
    packagegroup-eliza-evk-hexagon-dsp-binaries \
"

QCOM_CDT_FILE = "cdt_eliza_evk_0.7.0"
QCOM_BOOT_FILES_SUBDIR = "eliza"
QCOM_PARTITION_FILES_SUBDIR ?= "partitions/eliza-evk/emmc"

QCOM_BOOT_FIRMWARE = "firmware-qcom-boot-eliza"
QCOM_CDT_FIRMWARE = "firmware-qcom-cdt-eliza"
```

## conf/machine/hawi-mtp.conf
```bitbake
#@TYPE: Machine
#@NAME: Qualcomm Hawi MTP
#@DESCRIPTION: Machine configuration for Qualcomm Hawi (SM8975) MTP

require conf/machine/include/qcom-hawi.inc

MACHINE_FEATURES = "efi pci tpm2 usbhost usbgadget alsa wifi bluetooth"

QCOM_DTB_DEFAULT ?= "hawi-mtp"

KERNEL_DEVICETREE ?= " \
    qcom/hawi-mtp.dtb \
    "

MACHINE_ESSENTIAL_EXTRA_RRECOMMENDS += " \
    packagegroup-hawi-mtp-firmware \
    packagegroup-hawi-mtp-hexagon-dsp-binaries \
    "

QCOM_BOOT_FILES_SUBDIR = "hawi"
QCOM_PARTITION_FILES_SUBDIR ?= "partitions/hawi-mtp/ufs"
QCOM_BOOT_FIRMWARE = "firmware-qcom-boot-hawi"

# Bootloader configuration
ABL_SIGNATURE_VERSION ?= "v7"
```

## conf/machine/include/qcom-common-binary.inc
```bitbake
# This file specifies the necessary versions for the binary recipes.

VERSION_abseil-cpp ?= ""
PREFERRED_VERSION_abseil-cpp = "${VERSION_abseil-cpp}"
PREFERRED_VERSION_abseil-cpp-native = "${VERSION_abseil-cpp}"
PREFERRED_VERSION_nativesdk-abseil-cpp = "${VERSION_abseil-cpp}"

VERSION_protobuf ?= ""
PREFERRED_VERSION_protobuf = "${VERSION_protobuf}"
PREFERRED_VERSION_protobuf-native = "${VERSION_protobuf}"
PREFERRED_VERSION_nativesdk-protobuf = "${VERSION_protobuf}"
```

## conf/machine/include/qcom-hawi.inc
```bitbake
# Configurations and variables for SM8975 (Hawi) SoC family.

SOC_FAMILY = "hawi"

require conf/machine/include/qcom-base.inc
require conf/machine/include/qcom-common.inc

DEFAULTTUNE = "armv8-6a-crypto"
require conf/machine/include/arm/arch-armv8-6a.inc

MACHINE_ESSENTIAL_EXTRA_RRECOMMENDS += " \
    packagegroup-qcom-boot-essential \
    "

MACHINE_EXTRA_RRECOMMENDS += " \
    packagegroup-qcom-boot-additional \
    "
```

## conf/machine/include/qcom-nord.inc
```bitbake
# Configurations and variables for Nord SoC family.

SOC_FAMILY = "nord"
require conf/machine/include/qcom-base.inc
require conf/machine/include/qcom-common.inc

DEFAULTTUNE = "armv8-6a-crypto"
require conf/machine/include/arm/arch-armv8-6a.inc

MACHINE_ESSENTIAL_EXTRA_RRECOMMENDS += " \
    packagegroup-qcom-boot-essential \
    packagegroup-machine-essential-qcom-nord-soc \
"

MACHINE_EXTRA_RRECOMMENDS += " \
    packagegroup-qcom-boot-additional \
"
```

## conf/machine/include/qcom-sdx75.inc
```bitbake
SOC_FAMILY = "sdx75"
require conf/machine/include/qcom-common.inc

# SDX75 has no PCIe controller
MACHINE_FEATURES:remove = "pci"

PREFERRED_PROVIDER_virtual/kernel ?= "linux-qcom-next"

DEFAULTTUNE = "cortexa55"
require conf/machine/include/arm/armv8-2a/tune-cortexa55.inc

KERNEL_IMAGETYPE = "Image"

MACHINE_ESSENTIAL_EXTRA_RRECOMMENDS += " \
    qrtr \
    rmtfs \
    tqftpserv \
    pd-mapper \
"

# UBI filesystem settings
IMAGE_FSTYPES = "ubi"
QCOM_BOOTIMG_PAGE_SIZE ?= "4096"
```

## conf/machine/iq10-rrd.conf
```bitbake
#@TYPE: Machine
#@NAME: Qualcomm IQ10 RRD Reference Design
#@DESCRIPTION: Machine configuration for the Qualcomm IQ10 RRD board, with Qualcomm Nord

require conf/machine/include/qcom-nord.inc

MACHINE_FEATURES += "efi pci"

KERNEL_DEVICETREE ?= " \
                      qcom/nord-rrd.dtb \
                      qcom/nord-ride-sx.dtb \
                      "

MACHINE_ESSENTIAL_EXTRA_RRECOMMENDS += " \
    packagegroup-iq10-rrd-firmware \
    packagegroup-iq10-rrd-hexagon-dsp-binaries \
"

QCOM_CDT_FILE = "cdt_nord_ridesx_0.1.0"
QCOM_BOOT_FILES_SUBDIR = "nord"
QCOM_PARTITION_FILES_SUBDIR ?= "partitions/iq10-rrd/ufs"

QCOM_BOOT_FIRMWARE = "firmware-qcom-boot-nord"
QCOM_CDT_FIRMWARE = "firmware-qcom-cdt-nord"
```

## conf/machine/maili-mtp.conf
```bitbake
#@TYPE: Machine
#@NAME: Qualcomm Maili MTP
#@DESCRIPTION: Machine configuration for Qualcomm Maili (SM8950) MTP

require conf/machine/include/qcom-sm8950.inc

MACHINE_FEATURES += "efi pci tpm2"

KERNEL_DEVICETREE ?= " \
                      qcom/maili-mtp.dtb \
                      "
QCOM_DTB_DEFAULT ?= "maili-mtp"
QCOM_UKI_DEVICETREE = "${QCOM_DTB_DEFAULT}.dtb"

MACHINE_ESSENTIAL_EXTRA_RRECOMMENDS += " \
    packagegroup-maili-mtp-firmware \
    packagegroup-maili-mtp-hexagon-dsp-binaries \
"

# Bootloader configuration
ABL_SIGNATURE_VERSION ?= "v7"
QCOM_BOOT_FILES_SUBDIR = "maili"
QCOM_BOOT_FIRMWARE = "firmware-qcom-boot-maili"

QCOM_PARTITION_FILES_SUBDIR ?= "partitions/maili-mtp/ufs"
```
