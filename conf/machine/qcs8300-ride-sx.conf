## conf/machine/qcs8300-ride-sx.conf
```bitbake
#@TYPE: Machine
#@NAME: Qualcomm QCS8300 Ride SX Beta Evaluation Kit (EVK)
#@DESCRIPTION: Machine configuration for Qualcomm QCS8300 Ride SX Beta Evaluation Kit (EVK)

require conf/machine/include/qcom-qcs8300.inc

MACHINE_FEATURES += "efi pci"

QCOM_DTB_DEFAULT ?= "qcs8300-ride"

KERNEL_DEVICETREE ?= " \
                      qcom/qcs8300-ride.dtb \
                      "

# These DTs are not upstreamed and currently exist only in linux-qcom kernels
LINUX_QCOM_KERNEL_DEVICETREE ?= " \
                      qcom/monaco-el2.dtbo \
                      qcom/qcs8300-ride-camx.dtbo \
                      "

MACHINE_ESSENTIAL_EXTRA_RRECOMMENDS += " \
    packagegroup-qcs8300-ride-firmware \
    packagegroup-qcs8300-ride-hexagon-dsp-binaries \
    qairt-sdk-hexagon-v75 \
    qcom-fastcv-binaries-qcs8300-ride-dsp \
"

QCOM_CDT_FILE = "cdt_ride_sx"
QCOM_BOOT_FILES_SUBDIR = "qcs8300"
QCOM_PARTITION_FILES_SUBDIR ?= "partitions/qcs8300-ride-sx/ufs"

QCOM_BOOT_FIRMWARE = "firmware-qcom-boot-qcs8300"

# Isolate rt cpu
QCOM_RT_CPU        = "3"
QCOM_IRQAFF        = "0-2,4-7"
QCOM_RCU_NOCBS     = "3"
QCOM_RCU_EXPEDITED = "1"
QCOM_CPUIDLE_OFF   = "1"
```

## conf/machine/qcs9075-iq-9075-evk.conf
```bitbake
#@TYPE: Machine
#@NAME: Qualcomm IQ-9075 Evaluation Kit (EVK) based on QCS9075
#@DESCRIPTION: Machine configuration for Qualcomm IQ-9075 Evaluation Kit (EVK)

require conf/machine/include/qcom-qcs9100.inc

MACHINE_FEATURES += "efi pci"

QCOM_DTB_DEFAULT ?= "qcs9075-iq-9075-evk"

KERNEL_DEVICETREE ?= " \
                      qcom/qcs9075-iq-9075-evk.dtb \
                      "

MACHINE_ESSENTIAL_EXTRA_RRECOMMENDS += " \
    packagegroup-sa8775p-ride-firmware \
    packagegroup-sa8775p-ride-hexagon-dsp-binaries \
"

QCOM_CDT_FILE = "cdt_rb8_core_kit"
QCOM_BOOT_FILES_SUBDIR = "qcs9100"

# FIXME provide device-specific table
QCOM_PARTITION_FILES_SUBDIR = "partitions/qcs9100-ride-sx"

QCOM_BOOT_FIRMWARE = "firmware-qcom-boot-qcs9100"
```

## conf/machine/qcs9100-ride-sx.conf
```bitbake
#@TYPE: Machine
#@NAME: Qualcomm QCS9100 Ride SX Beta Evaluation Kit (EVK)
#@DESCRIPTION: Machine configuration for Qualcomm QCS9100 Ride SX Beta Evaluation Kit (EVK)

require conf/machine/include/qcom-qcs9100.inc

MACHINE_FEATURES += "efi pci"

QCOM_DTB_DEFAULT ?= "qcs9100-ride-r3"

KERNEL_DEVICETREE ?= " \
                      qcom/qcs9100-ride.dtb \
                      qcom/qcs9100-ride-r3.dtb \
                      qcom/sa8775p-ride.dtb \
                      qcom/sa8775p-ride-r3.dtb \
                      "

# These DTs are not upstreamed and currently exist only in linux-qcom kernels
LINUX_QCOM_KERNEL_DEVICETREE ?= " \
                      qcom/qcs9100-ride-r3-camx.dtb \
                      qcom/sa8775p-ride-camx.dtbo \
                      qcom/sa8775p-ride-r3-camx.dtb \
                      "

MACHINE_ESSENTIAL_EXTRA_RRECOMMENDS += " \
    packagegroup-sa8775p-ride-firmware \
    packagegroup-sa8775p-ride-hexagon-dsp-binaries \
    qairt-sdk-hexagon-v73 \
    qcom-fastcv-binaries-sa8775p-ride-dsp \
"

QCOM_CDT_FILE = "cdt_ride_sx"
QCOM_BOOT_FILES_SUBDIR = "qcs9100"
QCOM_PARTITION_FILES_SUBDIR ?= "partitions/qcs9100-ride-sx/ufs"

QCOM_BOOT_FIRMWARE = "firmware-qcom-boot-qcs9100"
```

## conf/machine/qrb2210-rb1-core-kit.conf
```bitbake
#@TYPE: Machine
#@NAME: Qualcomm RB1 Development Kit (Core Kit)
#@DESCRIPTION: Machine configuration for Qualcomm RB1 development Kit, with QRB2210 (aka QCM2290)
#DEPRECATED, use rb1-core-kit instead

require conf/machine/rb1-core-kit.conf
```

## conf/machine/rb1-core-kit.conf
```bitbake
#@TYPE: Machine
#@NAME: Qualcomm RB1 Development Kit (Core Kit)
#@DESCRIPTION: Machine configuration for Qualcomm RB1 development Kit, with QRB2210 (aka QCM2290)

require conf/machine/include/qcom-qcm2290.inc

MACHINE_FEATURES = "efi usbhost usbgadget alsa wifi bluetooth"

UBOOT_CONFIG = "qrb2210-rb1"

QCOM_DTB_DEFAULT ?= "qrb2210-rb1"

KERNEL_DEVICETREE ?= " \
                      qcom/qrb2210-rb1.dtb \
                      "

MACHINE_ESSENTIAL_EXTRA_RRECOMMENDS += " \
    packagegroup-rb1-firmware \
    packagegroup-rb1-hexagon-dsp-binaries \
"

QCOM_BOOT_FILES_SUBDIR = "qrb2210"
QCOM_PARTITION_FILES_SUBDIR ?= "partitions/qrb2210-rb1/emmc"

QCOM_BOOT_FIRMWARE = "firmware-qcom-boot-qrb2210"
```

## conf/machine/rb3gen2-core-kit.conf
```bitbake
#@TYPE: Machine
#@NAME: Qualcomm RB3Gen2 Development Kit (Core Kit)
#@DESCRIPTION: Machine configuration for Qualcomm RB3Gen2 development Kit, with QCS6490

require conf/machine/include/qcom-qcs6490.inc

# NOTE: TPM hardware is only present on rb3gen2-industrial kit
MACHINE_FEATURES += "efi pci tpm2"

KERNEL_DEVICETREE ?= " \
                      qcom/qcs6490-rb3gen2.dtb \
                      qcom/qcs6490-rb3gen2-industrial-mezzanine.dtbo \
                      qcom/qcs6490-rb3gen2-vision-mezzanine.dtbo \
                      "

# These DTs are not upstreamed and currently exist only in linux-qcom kernels
LINUX_QCOM_KERNEL_DEVICETREE ?= " \
                      qcom/qcs6490-rb3gen2-vision-mezzanine-camx.dtbo \
                      "

MACHINE_ESSENTIAL_EXTRA_RRECOMMENDS += " \
    packagegroup-rb3gen2-firmware \
    packagegroup-rb3gen2-hexagon-dsp-binaries \
    packagegroup-rb3gen2-industrial-mezzanine-firmware \
    qairt-sdk-hexagon-v68 \
    qcom-fastcv-binaries-thundercomm-rb3gen2-dsp \
"

QCOM_CDT_FILE = "cdt_core_kit"
QCOM_BOOT_FILES_SUBDIR = "qcm6490"
QCOM_PARTITION_FILES_SUBDIR ?= "partitions/qcs6490-rb3gen2/ufs"

QCOM_BOOT_FIRMWARE = "firmware-qcom-boot-qcs6490"

# Isolate rt cpu
QCOM_RT_CPU        = "7"
QCOM_IRQAFF        = "0-6"
QCOM_RCU_NOCBS     = "7"
QCOM_RCU_EXPEDITED = "1"
QCOM_CPUIDLE_OFF   = "1"

UBOOT_CONFIG_DEFAULT = "qcs6490-rb3gen2"
UBOOT_CONFIG = "qcs6490-rb3gen2"
UBOOT_CONFIG[qcs6490-rb3gen2] = "qcm6490_defconfig"
BOARD_MBN_HEADER[qcs6490-rb3gen2] = "v6"
```

## conf/machine/shikra-evk.conf
```bitbake
#@TYPE: Machine
#@NAME: Qualcomm Shikra Alpha Evaluation Kit (EVK)
#@DESCRIPTION: Machine configuration for Qualcomm Shikra Evaluation Kit (EVK)

require conf/machine/include/qcom-shikra.inc

MACHINE_FEATURES += "efi pci phone"

KERNEL_DEVICETREE ?= " \
                      qcom/shikra-cqm-evk.dtb \
                      qcom/shikra-cqs-evk.dtb \
                      qcom/shikra-iqs-evk.dtb \
                      qcom/shikra-cqm-evk-imx577-camera.dtbo \
                      qcom/shikra-iqs-evk-imx577-camera.dtbo \
                      "

MACHINE_ESSENTIAL_EXTRA_RRECOMMENDS += " \
    packagegroup-shikra-evk-firmware \
    packagegroup-shikra-evk-hexagon-dsp-binaries \
"

QCOM_CDT_FILE = "cdt_cq2390_itp_0.2.0"
QCOM_BOOT_FILES_SUBDIR = "shikra"
QCOM_PARTITION_FILES_SUBDIR ?= "partitions/shikra-evk/emmc"

QCOM_BOOT_FIRMWARE = "firmware-qcom-boot-shikra"
QCOM_CDT_FIRMWARE = "firmware-qcom-cdt-shikra"

UBOOT_CONFIG = "shikra-evk"
```

## conf/machine/shikra.conf
```bitbake
#@TYPE: Machine
#@NAME: Qualcomm Shikra Beta Evaluation Kit (EVK)
#@DESCRIPTION: Machine configuration for Qualcomm Shikra Evaluation Kit (EVK)

require conf/machine/include/qcom-shikra.inc

MACHINE_FEATURES += "efi pci phone"

KERNEL_DEVICETREE ?= " \
                      qcom/shikra-cqm-evk.dtb \
                      qcom/shikra-cqs-evk.dtb \
                      qcom/shikra-iqs-evk.dtb \
                      qcom/shikra-cqm-evk-imx577-camera.dtbo \
                      qcom/shikra-iqs-evk-imx577-camera.dtbo \
                      "

MACHINE_ESSENTIAL_EXTRA_RRECOMMENDS += " \
    packagegroup-shikra-firmware \
"

QCOM_CDT_FILE = ""
QCOM_BOOT_FILES_SUBDIR = "shikra"
QCOM_PARTITION_FILES_SUBDIR ?= "partitions/shikra/emmc"

QCOM_BOOT_FIRMWARE = ""
```

## conf/machine/sm8750-mtp.conf
```bitbake
#@TYPE: Machine
#@NAME: Qualcomm SM8750 Development Kit
#@DESCRIPTION: Machine configuration for Qualcomm SM8750 development Kit

require conf/machine/include/qcom-sm8750.inc

MACHINE_FEATURES = "efi usbhost usbgadget alsa wifi bluetooth"

QCOM_DTB_DEFAULT ?= "sm8750-mtp"

KERNEL_DEVICETREE ?= " \
                      qcom/sm8750-mtp.dtb \
                      "

MACHINE_ESSENTIAL_EXTRA_RRECOMMENDS += " \
    packagegroup-sm8750-mtp-firmware \
    packagegroup-sm8750-mtp-hexagon-dsp-binaries \
    qcom-fastcv-binaries-sm8750-mtp-dsp \
"

QCOM_CDT_FILE = "cdt_pakala_mtp_0.4.0"
QCOM_BOOT_FILES_SUBDIR = "sm8750"
QCOM_PARTITION_FILES_SUBDIR ?= "partitions/sm8750-mtp/ufs"

QCOM_BOOT_FIRMWARE = "firmware-qcom-boot-sm8750"
```

## meta-axiom-ci/conf/layer.conf
```bitbake
# We have a conf and classes directory, add to BBPATH
BBPATH .= ":${LAYERDIR}"

# We have a packages directory, add to BBFILES
BBFILES += "${LAYERDIR}/recipes-*/*/*.bb \
            ${LAYERDIR}/recipes-*/*/*.bbappend"

BBFILE_COLLECTIONS += "qcom-axiom-ci"
BBFILE_PATTERN_qcom-axiom-ci := "^${LAYERDIR}/"
BBFILE_PRIORITY_qcom-axiom-ci = "6"

LAYERDEPENDS_qcom-axiom-ci = "core openembedded-layer networking-layer qcom"
LAYERSERIES_COMPAT_qcom-axiom-ci = "styhead walnascar"
```

## meta-qcom-tip/conf/layer.conf
```bitbake
# We have a conf and classes directory, add to BBPATH
BBPATH .= ":${LAYERDIR}"

# We have recipes-* directories, add to BBFILES
BBFILES += "${LAYERDIR}/recipes-*/*/*.bb \
            ${LAYERDIR}/recipes-*/*/*.bbappend"

BBFILE_COLLECTIONS += "meta-qcom-tip"
BBFILE_PATTERN_meta-qcom-tip = "^${LAYERDIR}/"
BBFILE_PRIORITY_meta-qcom-tip = "9"

LAYERDEPENDS_meta-qcom-tip = "qcom"
LAYERSERIES_COMPAT_meta-qcom-tip = "walnascar"
```

## meta-qcom/conf/machine/include/qcom-apq8016.inc
```bitbake
SOC_FAMILY = "apq8016"
require conf/machine/include/qcom-common.inc
require conf/machine/include/arm/armv8a/tune-cortexa53.inc

MACHINE_ESSENTIAL_EXTRA_RRECOMMENDS += " \
    qrtr \
    rmtfs \
"

MACHINE_EXTRA_RRECOMMENDS += " \
    fastrpc \
"

# Android boot image settings
QCOM_BOOTIMG_PAGE_SIZE = "2048"
```

## meta-qcom/conf/machine/include/qcom-apq8064.inc
```bitbake
SOC_FAMILY = "apq8064"
require conf/machine/include/qcom-common.inc
DEFAULTTUNE = "cortexa15thf-neon-vfpv4"
require conf/machine/include/arm/armv7a/tune-cortexa15.inc

# Android boot image settings
QCOM_BOOTIMG_PAGE_SIZE = "2048"
```

## meta-qcom/conf/machine/include/qcom-apq8096.inc
```bitbake
SOC_FAMILY = "apq8096"
require conf/machine/include/qcom-common.inc
DEFAULTTUNE = "armv8a-crc-crypto"
require conf/machine/include/arm/arch-armv8a.inc

MACHINE_ESSENTIAL_EXTRA_RRECOMMENDS += " \
    qrtr \
    rmtfs \
"

MACHINE_EXTRA_RRECOMMENDS += " \
    fastrpc \
"
```

## meta-qcom/conf/machine/include/qcom-base.inc
```bitbake
# Common configurations and variables for Qualcomm platforms.

# Provider for linux kernel
PREFERRED_PROVIDER_virtual/kernel ?= "linux-yocto-dev"

KERNEL_IMAGETYPE ?= "Image"
KERNEL_ALT_IMAGETYPE ?= "vmlinux"

KERNEL_IMAGETYPES ?= "Image.gz"

# For dtb.bin generation
KERNEL_CLASSES += "linux-qcom-dtbbin"

# QDL expects 4096 aligned ext4 image for flashing
IMAGE_FSTYPES += "ext4"
IMAGE_ROOTFS_ALIGNMENT = "4096"
EXTRA_IMAGECMD:ext4 = "-i 4096 -b 4096"

SERIAL_CONSOLES ?= "115200;ttyMSM0"

QCOM_BOOTIMG_ROOTFS ?= "PARTLABEL=rootfs"
```

## meta-qcom/conf/machine/include/qcom-qcm2290.inc
```bitbake
# Configurations and variables for QCM2290 (aka QRB2210) SoC family.

SOC_FAMILY = "qcm2290"
require conf/machine/include/qcom-base.inc
require conf/machine/include/qcom-common.inc

QCOM_VFAT_SECTOR_SIZE = "512"

require conf/machine/include/arm/armv8a/tune-cortexa53.inc

KERNEL_CMDLINE_EXTRA ?= "clk_ignore_unused pd_ignore_unused"

MACHINE_ESSENTIAL_EXTRA_RRECOMMENDS += " \
    packagegroup-qcom-boot-essential \
    packagegroup-machine-essential-qcom-qcm2290-soc \
"

MACHINE_EXTRA_RRECOMMENDS += " \
    packagegroup-qcom-boot-additional \
"

EXTRA_IMAGEDEPENDS += "firmware-qcom-boot-qrb2210-rb1"
```

## meta-qcom/conf/machine/include/qcom-qcs404.inc
```bitbake
SOC_FAMILY = "qcs404"
require conf/machine/include/qcom-common.inc
require conf/machine/include/arm/arch-armv8a.inc

MACHINE_ESSENTIAL_EXTRA_RRECOMMENDS += " \
    qrtr \
"
```

## meta-qcom/conf/machine/include/qcom-qcs8300.inc
```bitbake
# Configurations and variables for QCS8300 SoC family.

SOC_FAMILY = "qcs8300"
require conf/machine/include/qcom-base.inc
require conf/machine/include/qcom-common.inc

DEFAULTTUNE = "armv8-2a-crypto"
require conf/machine/include/arm/arch-armv8-2a.inc

MACHINE_ESSENTIAL_EXTRA_RRECOMMENDS += " \
    packagegroup-qcom-boot-essential \
    packagegroup-machine-essential-qcom-qcs8300-soc \
"

MACHINE_EXTRA_RRECOMMENDS += " \
    packagegroup-qcom-boot-additional \
"

EXTRA_IMAGEDEPENDS += "firmware-qcom-boot-qcs8300"
```

## meta-qcom/conf/machine/include/qcom-qcs9100.inc
```bitbake
# Configurations and variables for QCS9100 SoC family.

SOC_FAMILY = "qcs9100"
require conf/machine/include/qcom-base.inc
require conf/machine/include/qcom-common.inc

DEFAULTTUNE = "armv8-2a-crypto"
require conf/machine/include/arm/arch-armv8-2a.inc

MACHINE_ESSENTIAL_EXTRA_RRECOMMENDS += " \
    packagegroup-qcom-boot-essential \
    packagegroup-machine-essential-qcom-qcs9100-soc \
"

MACHINE_EXTRA_RRECOMMENDS += " \
    packagegroup-qcom-boot-additional \
"

EXTRA_IMAGEDEPENDS += "firmware-qcom-boot-qcs9100"
```

## meta-qcom/conf/machine/include/qcom-sa8155p.inc
```bitbake
SOC_FAMILY = "sa8155p"
require conf/machine/include/qcom-common.inc
DEFAULTTUNE = "armv8-2a-crypto"
require conf/machine/include/arm/arch-armv8-2a.inc

MACHINE_ESSENTIAL_EXTRA_RRECOMMENDS += " \
    packagegroup-qcom-boot-essential \
"

MACHINE_EXTRA_RRECOMMENDS += " \
    packagegroup-qcom-boot-additional \
"
```

## meta-qcom/conf/machine/include/qcom-sdx55.inc
```bitbake
SOC_FAMILY = "sdx55"
require conf/machine/include/qcom-common.inc
require conf/machine/include/arm/armv7a/tune-cortexa7.inc

MACHINE_ESSENTIAL_EXTRA_RRECOMMENDS += " \
    qrtr \
    rmtfs \
"

# UBI filesystem settings
IMAGE_FSTYPES ?= "ubi"
QCOM_BOOTIMG_PAGE_SIZE ?= "4096"
```

## meta-qcom/conf/machine/qcm6490-idp.conf
```bitbake
#@TYPE: Machine
#@NAME: Qualcomm QCM6490 Integrated Development Platform
#@DESCRIPTION: Machine configuration for the Integrated Development Platform, with Qualcomm QCM6490

require conf/machine/include/qcom-qcs6490.inc

MACHINE_FEATURES += "efi pci"

KERNEL_DEVICETREE ?= " \
                      qcom/qcm6490-idp.dtb \
                      "

MACHINE_ESSENTIAL_EXTRA_RRECOMMENDS += " \
    packagegroup-rb3gen2-firmware \
    packagegroup-rb3gen2-hexagon-dsp-binaries \
"

#
# Configuration variables for linux-qcom-staging kernel
#

# These addon DTs are not yet upstreamed. Build them only in staging kernel
# to avoid conflicts with other kernel providers like linux-yocto-dev.
KERNEL_DEVICETREE:append:pn-linux-qcom-staging = " \
                      qcom/qcm6490-addons-idp.dtb \
                      qcom/qcm6490-addons-idp-amoled.dtb \
                      "
```

## meta-qcom/conf/machine/qcs8300-ride-sx.conf
```bitbake
#@TYPE: Machine
#@NAME: Qualcomm QCS8300 Ride SX Beta Evaluation Kit (EVK)
#@DESCRIPTION: Machine configuration for Qualcomm QCS8300 Ride SX Beta Evaluation Kit (EVK)

require conf/machine/include/qcom-qcs8300.inc

MACHINE_FEATURES += "efi pci"

QCOM_DTB_DEFAULT ?= "qcs8300-ride"

KERNEL_DEVICETREE ?= " \
                      qcom/qcs8300-ride.dtb \
                      "

MACHINE_ESSENTIAL_EXTRA_RRECOMMENDS += " \
    packagegroup-qcs8300-ride-firmware \
    packagegroup-qcs8300-ride-hexagon-dsp-binaries \
"

QCOM_CDT_FILE = "cdt_ride_sx"
QCOM_BOOT_FILES_SUBDIR = "qcs8300"
QCOM_PARTITION_CONF = "qcom-partition-conf-qcs8300-ride-sx"

#
# Configuration variables for linux-qcom-staging kernel
#

# These addon DTs are not yet upstreamed. Build them only in staging kernel
# to avoid conflicts with other kernel providers like linux-yocto-dev.
KERNEL_DEVICETREE:append:pn-linux-qcom-staging = " \
                      qcom/qcs8300-addons-ride.dtb \
                      "
```
